## test-firmware/sdkconfig.defaults
```kconfig
# Partition table
CONFIG_PARTITION_TABLE_CUSTOM=y
CONFIG_PARTITION_TABLE_CUSTOM_FILENAME="partitions.csv"

# NimBLE
CONFIG_BT_ENABLED=y
CONFIG_BT_NIMBLE_ENABLED=y
CONFIG_BT_NIMBLE_ROLE_PERIPHERAL=y
CONFIG_BT_NIMBLE_ROLE_CENTRAL=n
CONFIG_BT_NIMBLE_ROLE_OBSERVER=n
CONFIG_BT_NIMBLE_ROLE_BROADCASTER=n

# WiFi
CONFIG_ESP_WIFI_SOFTAP_SUPPORT=y

# OTA - allow plain HTTP
CONFIG_ESP_HTTPS_OTA_ALLOW_HTTP=y

# DHCP captive portal support
CONFIG_LWIP_DHCPS=y
CONFIG_ESP_ENABLE_DHCP_CAPTIVEPORTAL=y

# Log level
CONFIG_LOG_DEFAULT_LEVEL_INFO=y
```

## test-firmware/sdkconfig.defaults.esp32s3
```kconfig
# Target
CONFIG_IDF_TARGET="esp32s3"

# Flash size — default 4MB (use partitions-4mb.csv)
# Override to 8MB+ only when the actual chip flash is known to be larger
CONFIG_ESPTOOLPY_FLASHSIZE_4MB=y
```
